## config/boards/shields/matcha59/Kconfig.defconfig
```kconfig
if SHIELD_MATCHA59

config ZMK_KEYBOARD_NAME
    string "Keyboard Name"
    default "matcha59"

endif


if ZMK_DISPLAY

config I2C
    default y

config SSD1306
    default y

endif # ZMK_DISPLAY
```
